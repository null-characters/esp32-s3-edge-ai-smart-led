## prj-v1/tests/unit/testcase.yaml
```yaml
tests:
  prj.unit.presence_state:
    platform_allow: native_sim
    tags: unit
    timeout: 5
  prj.unit.fade_control:
    platform_allow: native_sim
    tags: unit
    timeout: 5
  prj.unit.uart_retry:
    platform_allow: native_sim
    tags: unit
    timeout: 5
  prj.unit.lighting_interface:
    platform_allow: native_sim
    tags: unit
    timeout: 5
  prj.unit.command_parser:
    platform_allow: native_sim
    tags: unit
    timeout: 5
  prj.unit.http_client:
    platform_allow: native_sim
    tags: unit
    timeout: 5
  prj.unit.sntp_time_sync:
    platform_allow: native_sim
    tags: unit
    timeout: 5
  prj.unit.weather_api:
    platform_allow: native_sim
    tags: unit
    timeout: 5
```

## prj-v3/sdkconfig.defaults
```kconfig
# ESP32-S3 配置
CONFIG_IDF_TARGET="esp32s3"
CONFIG_ESP32S3_DEFAULT_CPU_FREQ_240=y

# 自定义分区表
CONFIG_PARTITION_TABLE_CUSTOM=y
CONFIG_PARTITION_TABLE_CUSTOM_FILENAME="partitions.csv"
CONFIG_PARTITION_TABLE_FILENAME="partitions.csv"

# Flash 大小配置
CONFIG_ESPTOOLPY_FLASHSIZE_8MB=y
CONFIG_ESPTOOLPY_FLASHSIZE="8MB"

# PSRAM 配置（N16R8 开发板）
CONFIG_SPIRAM=y
CONFIG_SPIRAM_MODE_OCT=y
CONFIG_SPIRAM_SPEED_40M=y
CONFIG_SPIRAM_SIZE_8M=y
CONFIG_SPIRAM_ALLOW_BSS_SEG_EXTERNAL_MEMORY=y
CONFIG_SPIRAM_ALLOW_STACK_EXTERNAL_MEMORY=y
CONFIG_SPIRAM_ALLOW_HEAP_EXTERNAL_MEMORY=y

# Wi-Fi 配置
CONFIG_ESP_WIFI=y
CONFIG_ESP_WIFI_STA=y

# 日志配置
CONFIG_LOG_DEFAULT_LEVEL_INFO=y
CONFIG_LOG_MAXIMUM_LEVEL_DEBUG=y

# FreeRTOS 配置
CONFIG_FREERTOS_HZ=1000

# ESP-SR 配置
CONFIG_ESP_SR_ENABLE=y
CONFIG_ESP_SR_WAKENET_ENABLE=y
CONFIG_ESP_SR_MULTINET_ENABLE=y
```
